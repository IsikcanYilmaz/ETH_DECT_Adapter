## CMakeLists.txt
```
#
# Copyright (c) 2024 Nordic Semiconductor
#
# SPDX-License-Identifier: LicenseRef-Nordic-5-Clause
#

cmake_minimum_required(VERSION 3.20.0)

find_package(Zephyr REQUIRED HINTS $ENV{ZEPHYR_BASE})
project(hello_dect)

set(CMAKE_EXPORT_COMPILE_COMMANDS ON)

target_sources(app PRIVATE
    src/button.c
    src/dect_phy_events.c
    src/dect_phy.c
    src/serial.c
    src/dect_serial.c
    src/main.c
    src/tdma.c
    src/dect_uart.c
    src/led.c
    src/tester.c
)
```

## Kconfig
```
#
# Copyright (c) 2024 Nordic Semiconductor
#
# SPDX-License-Identifier: LicenseRef-Nordic-5-Clause
#

config CARRIER
	int "Carrier to use"
	default 0
	help
	   The availability of the channels and the exact regulation to use them varies in different countries.
	   See ETSI TS 103 636-2 5.4.2 for the calculation.
	   Band index 1 is set when the carrier is within the range of 525 to 551.
	   This is the only range allowed for band index 1 as other carriers will interfere with other radio devices, including LTE devices.

config NETWORK_ID
	int "Network ID"
	range 1 4294967295
	default 91

config RX_TIMEOUT_MS
	int "TIMEOUT" 
	range 1 10000
	default 10000
	help
	  Maximum single shot receive wait duration

config MCS
	int "MCS"
	default 3
	help
	   The MCS impacts how much data can fit into each subslot.

config SLOT
    int "DECT subslot count"
    default 1
    help
      Number of subslots per DECT packet (affects payload size).


config TX_POWER
	int "TX power"
	range 0 13
	default 13
	help
	   Transmission power, max 19 dBm due to hardware limitations.
	   See table 6.2.1-3 of ETSI TS 103 636-4 v1.5.1.
config MEASUREMENT_NUM
	int "Measurement Nuber"
	range 0 4294967295
	default 5000
	help
	   Number of measurements that are taken 

module = DECT_PHY_HELLO
module-str = DECT NR+ PHY Hello
source "$(ZEPHYR_BASE)/subsys/logging/Kconfig.template.log_config"

menu "Zephyr Kernel"
source "Kconfig.zephyr"
endmenu
```

## prj.conf
```kconfig
# JLINK
CONFIG_SEGGER_DEBUGMON=y
CONFIG_CORTEX_M_DEBUG_MONITOR_HOOK=y
CONFIG_USE_SEGGER_RTT=y
CONFIG_RTT_CONSOLE=y

CONFIG_SERIAL=y
CONFIG_UART_INTERRUPT_DRIVEN=y
# CONFIG_UART_ASYNC_API=y
CONFIG_NET_BUF=y
CONFIG_RING_BUFFER=y

# Logging
CONFIG_LOG=y
#CONFIG_LOG_MODE_IMMEDIATE=n
#CONFIG_LOG_MODE_DEFERRED=y
#CONFIG_LOG_MODE_MINIMAL=y
CONFIG_LOG_DEFAULT_LEVEL=3

# Dect Phy modem
CONFIG_NRF_MODEM_LIB=y
CONFIG_MODEM_ANTENNA=n
CONFIG_NRF_MODEM_LINK_BINARY_DECT_PHY=y
CONFIG_HWINFO=y
```

## dongle.overlay
```dts
/*
Enable uart1
*/

&uart1 {
	status="okay";
	/* current-speed= <921600>; */
	current-speed=<1000000>;
};
```

## boards/nrf9161dk_nrf9161.overlay
```dts
&uart0 {
    status = "okay";
    current-speed = <1000000>;
};
```

## src/main.c
```c
#include <zephyr/kernel.h>
#include <zephyr/logging/log.h>
#include <modem/nrf_modem_lib.h>
#include <zephyr/drivers/hwinfo.h>
#include <string.h>

#include "button.h"
#include "serial.h"
#include "dect_phy_events.h"
#include "dect_phy.h"
#include "ntp.h"
#include "dect_serial.h"
#include "tdma.h"
#include "led.h"

#include "tester.h"

LOG_MODULE_REGISTER(app,LOG_LEVEL_INF);

/*******************************************//**
 *  ... BUTTON SETUP
 ***********************************************/

void pressed(const struct device *dev, struct gpio_callback *cb, uint32_t pins);
BUTTON_DEFINE_DT(button1, DT_ALIAS(sw0), pressed);
BUTTON_DEFINE_DT(button2, DT_ALIAS(sw1), pressed);
BUTTON_DEFINE_DT(button3, DT_ALIAS(sw2), pressed);
BUTTON_DEFINE_DT(button4, DT_ALIAS(sw3), pressed);

K_SEM_DEFINE(test_sem,    0, 1);

static const char *teststr = "ASDFQWERASDFQWERASDFQWERASDFQWERASDFQWERASDFQWERASDFQWERASDFQWERASDFQWERASDFQWERASDFQWERASDFQWERASDFQWERASDFQWERASDFQWERASDFQWERASDFQWERASDFQWERASDFQWERASDFQWERASDFQWERASDFQWERASDFQWERASDFQWERASDFQWERASDFQWERASDFQWERASDFQWERASDFQWERASDFQWERASDFQWERASDFQWER";
void pressed(const struct device *dev, struct gpio_callback *cb, uint32_t pins)
{
	// TODO probably better way to do this mapping
	if (pins == (1 << button1.spec.pin))
	{
		mode = MASTER;
		LOG_INF("MODE MASTER");
	}
	else if (pins == (1 << button2.spec.pin))
	{
		mode = SLAVE;
		LOG_INF("MODE SLAVE");
	}
	else if (pins == (1 << button3.spec.pin))
	{
		mode = SINK;
		LOG_INF("MODE SINK");
	}
	else if (pins == (1 << button4.spec.pin))
	{
		// nrf_modem_dect_phy_time_get();
		//   static struct nrf_modem_dect_phy_hdr_type_1 tx_hdr = {
		//     .packet_length      = 1,
		//     .packet_length_type = 0x01,
		//     .header_format      = 0x0,
		//     .short_network_id   = (CONFIG_NETWORK_ID & 0xff),
		//     .transmitter_id_hi  = (0 >> 8) & 0xff,
		//     .transmitter_id_lo  = (0 & 0xff),
		//     .df_mcs             = FRAME_TX_MCS,
		//     .reserved           = 0,
		//     .transmit_power     = CONFIG_TX_POWER,
		//   };
		//
		//   uint64_t start_time = 0;
		//   LOG_INF("SENDING TEST PAYLOAD WITH %d USECOND DELAY", start_time);
		//   // k_sem_take(&tdma_sem, K_FOREVER);
		//   dect_phy_tx(TX_HANDLE, &tx_hdr, 32, teststr, start_time);
		//   k_sem_take(&tdma_sem, K_FOREVER);
		//   k_sem_reset(&tdma_sem);
    //
    // nrf_modem_dect_phy_capability_get();
	}
	LOG_INF("BUTTON PRESSED %s %d", dev->name, pins);
}

/* ===================== DECT RX CALLBACK ===================== */

int main(void)
{
	int err;
	uint16_t device_id;

	err = nrf_modem_lib_init();
	if (err) {
		LOG_ERR("Modem init failed: %d", err);
		return 0;
	}

	//dect_events_register_pdc_handler(on_pdc);
	LOG_DBG("PDC handler registered");

	// dect_phy_init();
	// LOG_DBG("DECT PHY initialized");

	serial_init();
	LOG_DBG("Serial initialized");

	button_init(&button1);
	button_init(&button2);
	button_init(&button3);
	button_init(&button4);
	LOG_DBG("Button initialized");

	led_init();

	// DectUart_Init();
	LOG_DBG("Dect UART Initialized");

	err = hwinfo_get_device_id((void *)&device_id, sizeof(device_id));
	if (err < 0) {
		LOG_ERR("Failed to get device ID: %d", err);
		device_id = 0;
	}
	LOG_DBG("Device ID: 0x%04x", device_id);

	while(mode == UNDEFINED_ROLE){
		LOG_INF("BUTTON1 FOR MASTER, BUTTON2 FOR SLAVE, BUTTON3 FOR SINK");
		k_sleep(K_MSEC(1000));
	}

  testloop(mode);

	led_set((mode == MASTER) ? MASTER_LED_ID : SLAVE_LED_ID, true);

	// dect_events_register_pcc_handler(tdma_on_pcc);
	// dect_events_register_pdc_handler(serial_on_pdc);
	// dect_events_register_pdc_handler(sink_serial_on_pdc);

	LOG_DBG("Dect serial initialized");
	init_tdma();
	LOG_DBG("Tdma initialized ID");
}
```

## src/button.c
```c
/*
 * Copyright (c) 2024 Nordic Semiconductor ASA
 *
 * SPDX-License-Identifier: LicenseRef-Nordic-5-Clause
 */

#include "button.h"
#include <zephyr/logging/log.h>

LOG_MODULE_REGISTER(button);

int button_init(button_t *btn)
{
	int err;
	/*
	if (!btn || !btn->handler) {
		LOG_ERR("button_init: invalid button descriptor");
		return -EINVAL;
	}
	*/
	if (!gpio_is_ready_dt(&btn->spec)) {
		LOG_ERR("GPIO device %s is not ready", btn->spec.port->name);
		return -ENODEV;
	}

	err = gpio_pin_configure_dt(&btn->spec, GPIO_INPUT);
	if (err) {
		LOG_ERR("Failed to configure %s pin %d: %d",
			btn->spec.port->name, btn->spec.pin, err);
		return err;
	}

	err = gpio_pin_interrupt_configure_dt(&btn->spec, GPIO_INT_EDGE_TO_ACTIVE);
	if (err) {
		LOG_ERR("Failed to configure interrupt on %s pin %d: %d",
			btn->spec.port->name, btn->spec.pin, err);
		return err;
	}

	gpio_init_callback(&btn->cb_data, btn->handler, BIT(btn->spec.pin));
	gpio_add_callback(btn->spec.port, &btn->cb_data);

	LOG_DBG("Button on %s pin %d initialised", btn->spec.port->name, btn->spec.pin);
	return 0;
}
```

## src/button.h
```c
/*
 * Copyright (c) 2024 Nordic Semiconductor ASA
 *
 * SPDX-License-Identifier: LicenseRef-Nordic-5-Clause
 */

#ifndef BUTTON_H
#define BUTTON_H

#include <zephyr/kernel.h>
#include <zephyr/drivers/gpio.h>

/**
 * @brief Descriptor for a single button.
 *
 * Populate this struct (usually via BUTTON_DEFINE) and pass it to
 * button_init() to configure the GPIO pin and attach an interrupt.
 *
 * The handler field uses Zephyr's own gpio_callback_handler_t:
 *   void handler(const struct device *dev, struct gpio_callback *cb, uint32_t pins)
 */
typedef struct {
	const struct gpio_dt_spec  spec;    /**< GPIO DT spec (port + pin + flags). */
	gpio_callback_handler_t    handler; /**< Callback invoked on press.          */
	struct gpio_callback       cb_data; /**< Internal callback data – do not set. */
} button_t;

/**
 * @brief Convenience macro for buttons described in the devicetree.
 *
 * Usage example:
 *   BUTTON_DEFINE_DT(my_button, DT_ALIAS(sw0), my_button_handler);
 *
 * @param _name     C identifier for the resulting button_t variable.
 * @param _node_id  DT node identifier (e.g. DT_ALIAS(sw0)).
 * @param _handler  Function of type gpio_callback_handler_t to call on press.
 */
#define BUTTON_DEFINE_DT(_name, _node_id, _handler) \
	button_t _name = {                           \
		.spec    = GPIO_DT_SPEC_GET(_node_id, gpios), \
		.handler = (_handler),                   \
	}

/**
 * @brief Initialise a button: configure pin as input, attach edge interrupt.
 *
 * Must be called once per button before the button can generate callbacks.
 *
 * @param btn Pointer to the button_t to initialise.
 * @return 0 on success, negative errno on failure.
 */
int button_init(button_t *btn);

#endif /* BUTTON_H */
```

## src/dect_phy.c
```c
/*
 * dect_phy.c — DECT NR+ PHY radio abstraction layer
 *
 * Owns:
 *   - operation_sem and deinit_sem (signalled by dect_phy_events.c)
 *   - phy_fatal_error flag
 *   - Modem lifecycle: init, configure, activate, deactivate, deinit
 *   - TX and RX primitives
 *   - dect_run_task() — generalised TX/RX loop
 *
 * Does NOT own:
 *   - Event callbacks (dect_phy_events.c)
 *   - Application logic (rtt.c, one_way_delay.c, etc.)
 *   - Radio parameter tables (radio_config.c)
 */

#include "dect_phy.h"
#include "dect_phy_events.h"

#include <string.h>
#include <zephyr/kernel.h>
#include <zephyr/logging/log.h>
#include <nrf_modem_dect_phy.h>

LOG_MODULE_REGISTER(dect_phy,LOG_LEVEL_INF);

uint64_t get_delay_us(uint8_t ss){
  return ss * ((10 /*ms*/ * 1000  /* to us */)/24 /*to slots*/ )/16 /* to subslots */ ;
}

int get_bit_count(int mcs, int subslot)
{
  if (mcs < 0 || mcs >= MCS_COUNT ||
    subslot < 0 || subslot >= SUBSLOT_COUNT) {
    return INVALID_BYTES;
  }

  return mcs_subslot_bits[mcs][subslot];
}

K_SEM_DEFINE(operation_sem, 0, 1);
K_SEM_DEFINE(deinit_sem,    0, 1);
K_SEM_DEFINE(time_sem,    0, 1);
K_SEM_DEFINE(tx_sem,    0, 1);
K_SEM_DEFINE(rx_sem,    0, 1);

volatile bool phy_fatal_error = false;

/* ------------------------------------------------------------------ */
/*  Modem configuration                                                */
/*                                                                      */
/*  band_group_index: 1 for ETSI band 1 (carriers 525–551),           */
/*                    0 for all other carriers.                        */
/*  TODO: check if HARQ should be enabled for specific tasks.         */
/* ------------------------------------------------------------------ */
static const struct nrf_modem_dect_phy_config_params phy_config = {
  .band_group_index       = ((CONFIG_CARRIER >= 525 && CONFIG_CARRIER <= 551) ? 1 : 0),
  .harq_rx_process_count  = 4,
  .harq_rx_expiry_time_us = 5000000,
};

/*  Public fns                                                        */
int dect_phy_init(void)
{
  int err;

  /* Bind our event dispatcher before touching the modem. */
  err = nrf_modem_dect_phy_event_handler_set(dect_phy_event_handler);
  if (err) {
    LOG_ERR("event_handler_set failed, err %d", err);
    return err;
  }

  err = nrf_modem_dect_phy_init();
  if (err) {
    LOG_ERR("nrf_modem_dect_phy_init failed, err %d", err);
    return err;
  }

  k_sem_take(&operation_sem, K_FOREVER);
  if (phy_fatal_error) {
    LOG_ERR("Fatal error during PHY init");
    return -EIO;
  }
  nrf_modem_dect_phy_latency_get();

  err = nrf_modem_dect_phy_configure(&phy_config);
  if (err) {
    LOG_ERR("nrf_modem_dect_phy_configure failed, err %d", err);
    return err;
  }

  k_sem_take(&operation_sem, K_FOREVER);
  if (phy_fatal_error) {
    LOG_ERR("Fatal error during PHY configure");
    return -EIO;
  }
    
  nrf_modem_dect_phy_capability_get();
  k_sem_take(&operation_sem, K_FOREVER);
  if (phy_fatal_error) {
    LOG_ERR("Fatal error during PHY capa get");
    return -EIO;
  }

  err = nrf_modem_dect_phy_activate(NRF_MODEM_DECT_PHY_RADIO_MODE_LOW_LATENCY);
  if (err) {
    LOG_ERR("nrf_modem_dect_phy_activate failed, err %d", err);
    return err;
  }

  k_sem_take(&operation_sem, K_FOREVER);
  if (phy_fatal_error) {
    LOG_ERR("Fatal error during PHY activate");
    return -EIO;
  }

  LOG_DBG("DECT PHY initialised");
  return 0;
}

int dect_phy_deinit(void)
{
  int err;

  err = nrf_modem_dect_phy_deactivate();
  if (err) {
    LOG_ERR("nrf_modem_dect_phy_deactivate failed, err %d", err);
    return err;
  }

  k_sem_take(&deinit_sem, K_FOREVER);

  err = nrf_modem_dect_phy_deinit();
  if (err) {
    LOG_ERR("nrf_modem_dect_phy_deinit failed, err %d", err);
    return err;
  }

  k_sem_take(&deinit_sem, K_FOREVER);

  LOG_INF("DECT PHY deinitialised");
  return 0;
}

/*  TX primitive        */
/** TODO Shouldnt functions be static */
int dect_phy_tx(uint32_t handle,
                struct nrf_modem_dect_phy_hdr_type_1 *hdr,
                uint32_t payload_len,
                uint8_t *buf,
                uint64_t start_time)
{
  /* phy_hdr must persist until the TX operation completes. */
  static union nrf_modem_dect_phy_hdr phy_hdr;
  phy_hdr.hdr_type_1 = *hdr;

  struct nrf_modem_dect_phy_tx_params tx_params = {
    .start_time           = start_time,
    .handle               = handle,
    .network_id           = CONFIG_NETWORK_ID,
    .phy_type             = 0,
    .lbt_rssi_threshold_max = 0,
    .carrier              = CONFIG_CARRIER,
    .lbt_period           = 0,
    .phy_header           = &phy_hdr,
    .data                 = buf,
    .data_size            = payload_len,
  };

  int err = nrf_modem_dect_phy_tx(&tx_params);
  if (err) {
    LOG_ERR("nrf_modem_dect_phy_tx failed, err %d", err);
  }

  return err;
}

/*  RX primitive                                                       */
int dect_phy_rx(uint32_t handle, enum nrf_modem_dect_phy_rx_mode rx_mode,uint64_t start_time, uint32_t duration)
{
  const struct nrf_modem_dect_phy_rx_params rx_params = {
    .start_time                   = start_time,
    .handle                       = handle,
    .network_id                   = CONFIG_NETWORK_ID,
    .mode                         = rx_mode,
    .rssi_interval                = NRF_MODEM_DECT_PHY_RSSI_INTERVAL_OFF,
    .link_id                      = NRF_MODEM_DECT_PHY_LINK_UNSPECIFIED,
    .rssi_level                   = 0,
    .carrier                      = CONFIG_CARRIER,
    .duration                     = duration,//CONFIG_RX_TIMEOUT_MS * NRF_MODEM_DECT_MODEM_TIME_TICK_RATE_KHZ,
    .filter.short_network_id      = CONFIG_NETWORK_ID & 0xff,
    .filter.is_short_network_id_used = 1,
    .filter.receiver_identity     = 0,   /* broadcast — accept all */
  };

  int err = nrf_modem_dect_phy_rx(&rx_params);
  if (err) {
    LOG_ERR("nrf_modem_dect_phy_rx failed, err %d", err);
  }

  return err;
}
```

## src/dect_phy.h
```c
/*
 * dect_phy.h — DECT NR+ PHY radio abstraction layer
 *
 * Owns the modem lifecycle, TX/RX primitives, and the generalised task runner.
 * All modem interaction goes through this module — no other file calls
 * nrf_modem_dect_phy_tx() or nrf_modem_dect_phy_rx() directly.
 *
 * Usage:
 *   1. Call dect_phy_init() after nrf_modem_lib_init().
 *   2. Register application PDC/PCC handlers via dect_phy_events.h.
 *   3. Call dect_run_task() to execute a TX/RX task.
 *   4. Call dect_phy_deinit() before nrf_modem_lib_shutdown().
 */

#ifndef DECT_PHY_H
#define DECT_PHY_H
#define US_TO_MODEM_TICKS(us) (((uint64_t)(us)/1000 )* NRF_MODEM_DECT_MODEM_TIME_TICK_RATE_KHZ )

#include <stdint.h>
#include <stdbool.h>
#include <stddef.h>

#include <nrf_modem_dect_phy.h>


#define TX_HANDLE         0
#define RX_HANDLE         1
#define PAYLOAD_LEN_MAX 700

/* ------------------------------------------------------------------ */
/*  Sweep parameters                                                   */
/* ------------------------------------------------------------------ */

#define MCS_COUNT     5
#define SUBSLOT_COUNT 16

/** @brief Sentinel value returned by get_bit_count() for invalid combos. */
#define INVALID_BYTES -1

/* ------------------------------------------------------------------ */
/*  Owned variables (extern for read access by dect_phy_events.c)     */
/* ------------------------------------------------------------------ */
extern const int mcs_subslot_bits[MCS_COUNT][SUBSLOT_COUNT];
//extern struct nrf_modem_dect_phy_latency_info latency;
/* ------------------------------------------------------------------ */
/*  MCS / subslot payload size table                                   */
/* ------------------------------------------------------------------ */

/**
 * @brief Payload sizes in bits for each MCS and subslot combination.
 *
 * Rows  = MCS index (0–4)
 * Cols  = subslot count (0–15)
 *
 * INVALID_BYTES marks combinations that are not supported by the standard.
 *
 * @note Values are in bits. Divide by 8 to get bytes.
 *       TODO: rename to mcs_subslot_bits once all callers are updated.
 */
extern const int mcs_subslot_bits[MCS_COUNT][SUBSLOT_COUNT];

/* ------------------------------------------------------------------ */
/*  Lookup function                                                    */
/* ------------------------------------------------------------------ */

/**
 * @brief Get the payload size in bits for a given MCS and subslot.
 *
 * @param mcs     MCS index. Valid range: [0, MCS_COUNT).
 * @param subslot Subslot count. Valid range: [0, SUBSLOT_COUNT).
 *
 * @retval >0           Payload size in bits.
 * @retval INVALID_BYTES  Combination not supported, or arguments out of range.
 */
int get_bit_count(int mcs, int subslot);

/**
 * @brief Get the send time duration for a subslot length
 *
 * @param ss Subslot count. Valid range: [0, SUBSLOT_COUNT).
 *
 * @retval duration in micro seconds
 */
uint64_t get_delay_us(uint8_t ss);

extern struct k_sem operation_sem;
extern struct k_sem rx_sem;
extern struct k_sem tx_sem;
extern struct k_sem time_sem;
extern struct k_sem tdma_sem;

/**
 * @brief Semaphore signalled by on_deinit and on_deactivate callbacks.
 *
 * Separate from operation_sem because deactivate/deinit follow a different
 * lifecycle path than normal operations.
 */
extern struct k_sem deinit_sem;

/**
 * @brief Set to true by on_init or on_activate if a fatal modem error occurs.
 *
 * Checked after k_sem_take(operation_sem) during init sequence.
 * If true, the modem cannot be used and the application should shut down.
 */
extern volatile bool phy_fatal_error;

/* ------------------------------------------------------------------ */
/*  Lifecycle                                                          */
/* ------------------------------------------------------------------ */
/**
 * @brief Initialise the DECT PHY modem.
 *
 * Registers the event handler, initialises, configures, and activates
 * the modem in low-latency radio mode. Blocks until each step completes.
 *
 * Must be called after nrf_modem_lib_init() and before any TX/RX operation.
 *
 * @retval  0       Success.
 * @retval -EIO     Fatal modem error during init or activate.
 * @retval -errno   Modem API error.
 */
int dect_phy_init(void);

/**
 * @brief Deactivate and deinitialise the DECT PHY modem.
 *
 * Blocks until deactivation and deinit complete.
 * Call nrf_modem_lib_shutdown() after this returns.
 *
 * @retval  0       Success.
 * @retval -errno   Modem API error.
 */
int dect_phy_deinit(void);

/* ------------------------------------------------------------------ */
/*  Primitives (available for advanced use — prefer dect_run_task)    */
/* ------------------------------------------------------------------ */

/**
 * @brief Transmit a packet.
 *
 * Assembles TX params and calls nrf_modem_dect_phy_tx(). Does not wait
 * for completion — caller must k_sem_take(operation_sem) afterwards.
 *
 * @param handle      TX operation handle. Must be unique per in-flight op.
 * @param hdr         PHY header type 1 to transmit.
 * @param payload_len Payload length in bytes.
 * @param buf         Payload buffer. Must remain valid until op completes.
 * @param start_time        Time at which to send package. Leave at 0 for instanttransmit
 *
 * @retval  0       Success.
 * @retval -errno   Modem API error.
 */
int dect_phy_tx(uint32_t handle,
                struct nrf_modem_dect_phy_hdr_type_1 *hdr,
                uint32_t payload_len,
                uint8_t *buf,
                uint64_t start_time);

/**
 * @brief Start a receive operation.
 *
 * Assembles RX params and calls nrf_modem_dect_phy_rx(). Does not wait
 * for completion — caller must k_sem_take(operation_sem) afterwards.
 *
 * @param handle   RX operation handle.
 * @param rx_mode  Reception mode (single shot, continuous, etc.).
 * @param start_time        Time at which to send package. Leave at 0 for instanttransmit
 *
 * @retval  0       Success.
 * @retval -errno   Modem API error.
 */
int dect_phy_rx(uint32_t handle, enum nrf_modem_dect_phy_rx_mode rx_mode,uint64_t start_time, uint32_t duration);

#endif /* DECT_PHY_H */
```

## src/dect_phy_events.c
```c
/*
 * dect_phy_events.c — DECT PHY event dispatcher and application hook registration
 *
 * Owns:
 *   - All on_* internal callbacks
 *   - modem_time and last_rx_hdr shared state
 *   - Application handler registration (setters)
 *   - The top-level dect_phy_event_handler dispatcher
 *
 * Does NOT own:
 *   - Semaphores (defined in dect_phy.c, extern'd here)
 *   - TX/RX logic
 *   - Any task-specific state (RTT timestamps, echo flags, etc.)
 */

#include "dect_phy_events.h"

#include <zephyr/kernel.h>
#include <zephyr/logging/log.h>

LOG_MODULE_REGISTER(dect_phy_events,LOG_LEVEL_ERR);

/* ------------------------------------------------------------------ */
/*  Shared modem state                                                 */
/* ------------------------------------------------------------------ */

volatile uint64_t modem_time;
struct nrf_modem_dect_phy_latency_info *latency_info;
struct nrf_modem_dect_phy_hdr_type_1 last_rx_hdr;

/* ------------------------------------------------------------------ */
/*  Semaphores owned by dect_phy.c                                     */
/*                                                                      */
/*  extern here because the event callbacks are what signal them, but  */
/*  the semaphores themselves are defined and waited on in dect_phy.c. */
/* ------------------------------------------------------------------ */
extern struct k_sem operation_sem;
extern struct k_sem deinit_sem;
extern struct k_sem rx_sem;
extern struct k_sem tx_sem;
extern struct k_sem time_sem;
extern struct k_sem tdma_sem;

/* Flag set by on_init / on_activate to signal fatal error to main.    */
/** EVIL */
extern volatile bool phy_fatal_error;

/* ------------------------------------------------------------------ */
/*  Registered application handlers (private)                          */
/* ------------------------------------------------------------------ */

static pdc_handler_t         app_pdc_handler         = NULL;
static pcc_handler_t         app_pcc_handler         = NULL;
static pdc_crc_err_handler_t app_pdc_crc_err_handler = NULL;
static capability_get_handler_t app_capabilities_get_handler = NULL;

/* ------------------------------------------------------------------ */
/*  Setter implementations                                             */
/* ------------------------------------------------------------------ */

void dect_events_register_pdc_handler(pdc_handler_t handler)
{
  app_pdc_handler = handler;
}

void dect_events_register_pcc_handler(pcc_handler_t handler)
{
  app_pcc_handler = handler;
}

void dect_events_register_pdc_crc_err_handler(pdc_crc_err_handler_t handler)
{
  app_pdc_crc_err_handler = handler;
}

void dect_events_register_capability_get_handler(capability_get_handler_t handler)
{
  app_capabilities_get_handler = handler;
}

/* ------------------------------------------------------------------ */
/*  Internal callbacks                                                 */
/* ------------------------------------------------------------------ */

static void on_init(const struct nrf_modem_dect_phy_init_event *evt)
{
  if (evt->err) {
    LOG_ERR("Init failed, err %d", evt->err);
    phy_fatal_error = true;
    return;
  }

  LOG_DBG("on_init: giving operation_sem (err=%d)", evt->err);
  k_sem_give(&operation_sem);
}

static void on_deinit(const struct nrf_modem_dect_phy_deinit_event *evt)
{
  if (evt->err) {
    LOG_ERR("Deinit failed, err %d", evt->err);
    return;
  }

  LOG_DBG("on_deinit: giving deinit_sem (err=%d)", evt->err);
  k_sem_give(&deinit_sem);
}

static void on_activate(const struct nrf_modem_dect_phy_activate_event *evt)
{
  if (evt->err) {
    LOG_ERR("Activate failed, err %d", evt->err);
    phy_fatal_error = true;
    return;
  }

  LOG_DBG("on_activate: giving operation_sem (err=%d)", evt->err);
  k_sem_give(&operation_sem);
}

static void on_deactivate(const struct nrf_modem_dect_phy_deactivate_event *evt)
{
  if (evt->err) {
    LOG_ERR("Deactivate failed, err %d", evt->err);
    return;
  }

  LOG_DBG("on_deactivate: giving deinit_sem (err=%d)", evt->err);
  k_sem_give(&deinit_sem);
}

static void on_configure(const struct nrf_modem_dect_phy_configure_event *evt)
{
  if (evt->err) {
    LOG_ERR("Configure failed, err %d", evt->err);
    return;
  }

  LOG_DBG("on_configure: giving operation_sem (err=%d)", evt->err);
  k_sem_give(&operation_sem);
}

static void on_radio_config(const struct nrf_modem_dect_phy_radio_config_event *evt)
{
  if (evt->err) {
    LOG_ERR("Radio config failed, err %d", evt->err);
    return;
  }

  LOG_DBG("on_radio_config: giving operation_sem (err=%d)", evt->err);
  k_sem_give(&operation_sem);
}

static void on_op_complete(const struct nrf_modem_dect_phy_op_complete_event *evt)
{
  LOG_DBG("on_op_complete: time=%" PRIu64 " err=%d -> giving operation_sem + tx_sem", modem_time, evt->err);

  k_sem_give(&operation_sem);
  k_sem_give(&tdma_sem);
}

static void on_cancel(const struct nrf_modem_dect_phy_cancel_event *evt)
{
  LOG_DBG("on_cancel: err=%d -> giving operation_sem", evt->err);

  k_sem_give(&operation_sem);
}
static void on_time_get(const struct nrf_modem_dect_phy_time_get_event *evt)
{
  LOG_DBG("on_time_get: time=%" PRIu64 " err=%d -> giving time_sem", modem_time, evt->err);

  k_sem_give(&time_sem);
}

/* ------------------------------------------------------------------ */
/*  Application-hookable callbacks                                     */
/* ------------------------------------------------------------------ */

/**
 * Captures the header into last_rx_hdr (always), then calls the
 * optional application PCC handler.
 */
static void on_pcc(const struct nrf_modem_dect_phy_pcc_event *evt)
{
  LOG_DBG("PCC from device ID %d",
          evt->hdr.hdr_type_1.transmitter_id_hi << 8 |
          evt->hdr.hdr_type_1.transmitter_id_lo);
  LOG_DBG("  Short Network ID  : %u", evt->hdr.hdr_type_1.short_network_id);
  LOG_DBG("  Header Format     : %u", evt->hdr.hdr_type_1.header_format);
  LOG_DBG("  Packet Length     : %u %s",
          evt->hdr.hdr_type_1.packet_length,
          evt->hdr.hdr_type_1.packet_length_type ? "slots" : "subslots");
  LOG_DBG("  DF MCS            : %u", evt->hdr.hdr_type_1.df_mcs);
  LOG_DBG("  Transmit Power    : %u", evt->hdr.hdr_type_1.transmit_power);

  /* Always capture — tasks read this without registering a PCC handler. */
  last_rx_hdr = evt->hdr.hdr_type_1;

  if (app_pcc_handler) {
    app_pcc_handler(evt);
  }
}

static void on_pcc_crc_err(const struct nrf_modem_dect_phy_pcc_crc_failure_event *evt)
{
  LOG_DBG("pcc_crc_err cb time %" PRIu64, modem_time);
  /* No application hook for PCC CRC errors — add one here if needed. */
}

/**
 * Forwards raw payload to the registered application handler.
 * The handler is responsible for all task-specific logic
 * (echo, timestamping, buffering, etc.).
 */
static void on_pdc(const struct nrf_modem_dect_phy_pdc_event *evt)
{
  LOG_DBG("PDC data len: %d", evt->len);
  LOG_HEXDUMP_DBG(evt->data, evt->len, "PDC Payload");

  if (app_pdc_handler) {
    app_pdc_handler(evt);
  }
}

static void on_pdc_crc_err(const struct nrf_modem_dect_phy_pdc_crc_failure_event *evt)
{
  LOG_DBG("pdc_crc_err cb time %" PRIu64, modem_time);

  if (app_pdc_crc_err_handler) {
    app_pdc_crc_err_handler(modem_time);
  }
}

/* ------------------------------------------------------------------ */
/*  Informational callbacks (no application hook needed)              */
/* ------------------------------------------------------------------ */

static void on_rssi(const struct nrf_modem_dect_phy_rssi_event *evt)
{
  LOG_DBG("rssi cb time %" PRIu64 " carrier %d", modem_time, evt->carrier);
}

static void on_capability_get(const struct nrf_modem_dect_phy_capability_get_event *evt)
{
  if (app_capabilities_get_handler != NULL)
  {
    app_capabilities_get_handler(evt);
  }
  LOG_DBG("capability_get cb time %" PRIu64 " status %d", modem_time, evt->err);
}

static void on_bands_get(const struct nrf_modem_dect_phy_band_get_event *evt)
{
  LOG_DBG("bands_get cb status %d", evt->err);
}

static void on_latency_info_get(const struct nrf_modem_dect_phy_latency_info_event *evt)
{
  if (evt->err) 
  {
    LOG_ERR("latency_info_get cb status %d", evt->err);
    return;
  }
  latency_info = evt->latency_info;
}

static void on_link_config(const struct nrf_modem_dect_phy_link_config_event *evt)
{
  LOG_DBG("link_config cb time %" PRIu64 " status %d", modem_time, evt->err);
}

static void on_stf_cover_seq_control(const struct nrf_modem_dect_phy_stf_control_event *evt)
{
  LOG_WRN("Unexpectedly in %s", __func__);
}

static void on_test_rf_tx_cw_ctrl(
  const struct nrf_modem_dect_phy_test_rf_tx_cw_control_event *evt)
{
  LOG_WRN("Unexpectedly in %s", __func__);
}

/* ------------------------------------------------------------------ */
/*  Top-level dispatcher                                               */
/* ------------------------------------------------------------------ */

void dect_phy_event_handler(const struct nrf_modem_dect_phy_event *evt)
{
  /* Update shared timestamp first — all callbacks may read it. */
  modem_time = evt->time;

  switch (evt->id) {
    case NRF_MODEM_DECT_PHY_EVT_INIT:
      on_init(&evt->init);
      break;
    case NRF_MODEM_DECT_PHY_EVT_DEINIT:
      on_deinit(&evt->deinit);
      break;
    case NRF_MODEM_DECT_PHY_EVT_ACTIVATE:
      on_activate(&evt->activate);
      break;
    case NRF_MODEM_DECT_PHY_EVT_DEACTIVATE:
      on_deactivate(&evt->deactivate);
      break;
    case NRF_MODEM_DECT_PHY_EVT_CONFIGURE:
      on_configure(&evt->configure);
      break;
    case NRF_MODEM_DECT_PHY_EVT_RADIO_CONFIG:
      on_radio_config(&evt->radio_config);
      break;
    case NRF_MODEM_DECT_PHY_EVT_COMPLETED:
      on_op_complete(&evt->op_complete);
      break;
    case NRF_MODEM_DECT_PHY_EVT_CANCELED:
      on_cancel(&evt->cancel);
      break;
    case NRF_MODEM_DECT_PHY_EVT_RSSI:
      on_rssi(&evt->rssi);
      break;
    case NRF_MODEM_DECT_PHY_EVT_PCC:
      on_pcc(&evt->pcc);
      break;
    case NRF_MODEM_DECT_PHY_EVT_PCC_ERROR:
      on_pcc_crc_err(&evt->pcc_crc_err);
      break;
    case NRF_MODEM_DECT_PHY_EVT_PDC:
      on_pdc(&evt->pdc);
      break;
    case NRF_MODEM_DECT_PHY_EVT_PDC_ERROR:
      on_pdc_crc_err(&evt->pdc_crc_err);
      break;
    case NRF_MODEM_DECT_PHY_EVT_TIME:
      on_time_get(&evt->time_get);
      break;
    case NRF_MODEM_DECT_PHY_EVT_CAPABILITY:
      on_capability_get(&evt->capability_get);
      break;
    case NRF_MODEM_DECT_PHY_EVT_BANDS:
      on_bands_get(&evt->band_get);
      break;
    case NRF_MODEM_DECT_PHY_EVT_LATENCY:
      on_latency_info_get(&evt->latency_get);
      break;
    case NRF_MODEM_DECT_PHY_EVT_LINK_CONFIG:
      on_link_config(&evt->link_config);
      break;
    case NRF_MODEM_DECT_PHY_EVT_STF_CONFIG:
      on_stf_cover_seq_control(&evt->stf_cover_seq_control);
      break;
    case NRF_MODEM_DECT_PHY_EVT_TEST_RF_TX_CW_CONTROL_CONFIG:
      on_test_rf_tx_cw_ctrl(&evt->test_rf_tx_cw_control);
      break;
    default:
      LOG_WRN("Unhandled event id: %d", evt->id);
      break;
  }
}
```

## src/dect_phy_events.h
```c
/*
 * dect_phy_events.h — DECT PHY event dispatcher and application hook registration
 *
 * This module owns the single Zephyr-facing event handler and dispatches
 * each event to an internal on_* callback.
 *
 * For events that carry application-specific behaviour (pcc, pdc, pdc_crc_err),
 * the application registers a handler at runtime via the register functions
 * below.  All other events are handled internally (semaphore signalling,
 * logging) and do not need application involvement.
 *
 * Usage:
 *   1. Call dect_events_register_pdc_handler() before starting any task.
 *   2. Pass dect_phy_event_handler to nrf_modem_dect_phy_event_handler_set().
 */

#ifndef DECT_PHY_EVENTS_H
#define DECT_PHY_EVENTS_H

#include <stddef.h>
#include <stdint.h>
#include <stdbool.h>
#include <nrf_modem_dect_phy.h>

extern volatile uint64_t modem_time;
extern struct nrf_modem_dect_phy_latency_info *latency_info;
/* ------------------------------------------------------------------ */
/*  Application callback types                                         */
/* ------------------------------------------------------------------ */

/**
 * @brief Called when a PDC (data) event is received.
 *
 * @param data  Pointer to received payload. Valid only during the callback.
 * @param len   Length of @p data in bytes.
 */
typedef void (*pdc_handler_t)(const struct nrf_modem_dect_phy_pdc_event *evt);

/**
 * @brief Called when a PCC (header) event is received.
 *
 * @param hdr  Pointer to the received PHY header type 1.
 */
typedef void (*pcc_handler_t)(const struct nrf_modem_dect_phy_pcc_event *evt);

/**
 * @brief Called when a PDC CRC error is detected.
 *
 * @param time  Modem timestamp of the error.
 */
typedef void (*pdc_crc_err_handler_t)(uint64_t time);

/**
 * @brief Called when a capabilities get response comes in
 *
 * @param evt
 */
typedef void (*capability_get_handler_t)(const struct nrf_modem_dect_phy_capability_get_event *evt);

/* ------------------------------------------------------------------ */
/*  Handler registration (setters)                                     */
/* ------------------------------------------------------------------ */

/**
 * @brief Register the application PDC handler.
 *
 * Replaces any previously registered handler. Pass NULL to clear.
 * Must be called before starting a task that expects data reception.
 *
 * @param handler  Function to call on PDC event. May be NULL.
 */
void dect_events_register_pdc_handler(pdc_handler_t handler);

/**
 * @brief Register the application PCC handler.
 *
 * @param handler  Function to call on PCC event. May be NULL.
 */
void dect_events_register_pcc_handler(pcc_handler_t handler);

/**
 * @brief Register the application PDC CRC error handler.
 *
 * Useful for tasks that track error rates (e.g. link quality measurement).
 *
 * @param handler  Function to call on PDC CRC error. May be NULL.
 */
void dect_events_register_pdc_crc_err_handler(pdc_crc_err_handler_t handler);

/**
 * @brief Register the application for capability get handler
 *
 * @param handler function to call on capability get
 */
void dect_events_register_capability_get_handler(capability_get_handler_t handler);

/* ------------------------------------------------------------------ */
/*  Zephyr-facing event handler                                        */
/* ------------------------------------------------------------------ */

/**
 * @brief Top-level DECT PHY event handler.
 *
 * Pass this to nrf_modem_dect_phy_event_handler_set() during initialisation.
 * Do not call directly.
 */
void dect_phy_event_handler(const struct nrf_modem_dect_phy_event *evt);

/* ------------------------------------------------------------------ */
/*  Getter function                                                   */
/* ------------------------------------------------------------------ */
#endif /* DECT_PHY_EVENTS_H */
```

## src/dect_serial.c
```c
#include "dect_serial.h"
#include "dect_phy_events.h"
#include "tdma.h"

LOG_MODULE_REGISTER(dect_serial,LOG_LEVEL_INF);

#define PAYLOAD_MAX 141 // MCS 3 with ss len 2
#define DECT_LEN_PREFIX 2

static uint8_t tx_buf[PAYLOAD_LEN_MAX * TDMA_MAX_TRANSMISSIONS];
static uint8_t serial_buf[PAYLOAD_MAX - DECT_LEN_PREFIX];

uint8_t dect_rx_buf[PAYLOAD_MAX];
static volatile size_t dect_rx_len = 0;
static volatile bool dect_rx_flag = false;

struct nrf_modem_dect_phy_hdr_type_1 tx_hdr = {
	.packet_length      = FRAME_TX_SS,
	.packet_length_type = 0x00,
	.header_format      = 0x0,
	.short_network_id   = (CONFIG_NETWORK_ID & 0xff),
	.transmitter_id_hi  = (0 >> 8) & 0xff,
	.transmitter_id_lo  = (0 & 0xff),
	.df_mcs             = FRAME_TX_MCS,
	.reserved           = 0,
	.transmit_power     = CONFIG_TX_POWER,
};

int serial_to_dect(uint64_t start_time, uint64_t duration_us)
{
	/*
		 * Approximate one TX slot airtime.
		 * Later this should be replaced with the RTT matrix lookup:
		 * airtime = rtt_matrix[...]/2;
		 */
	//uint64_t airtime = 2 * get_delay_us(FRAME_TX_SS + 1);
	uint64_t airtime = 8000;

	if (airtime == 0) {
		LOG_ERR("Invalid airtime");
		return 0;
	}

	/* Maximum number of transmissions that fit into the window */
	uint16_t max_tx = duration_us / airtime;
	LOG_DBG("Max transmissions %u",max_tx);

	size_t avail = serial_rx_available();
	if ((int32_t)avail < 0) {
		LOG_ERR("serial_rx_available failed: %d", (int32_t)avail);
		return 0;
	}

	if (avail == 0) {
		LOG_DBG("No serial data available");
		return 0;
	}

	const size_t max_chunk = PAYLOAD_MAX - DECT_LEN_PREFIX;

	uint16_t chunks =
		(avail + max_chunk - 1) / max_chunk;

	uint16_t tx_count = MIN(MIN(chunks, max_tx), TDMA_MAX_TRANSMISSIONS);

	LOG_DBG("Scheduling %u/%u transmissions (airtime=%llu us)",
				 tx_count,
				 chunks,
				 airtime);

	size_t tx_buf_offset = 0;

	for (uint16_t i = 0; i < tx_count; i++) {

		avail = serial_rx_available();
		if (avail == 0) {
			break;
		}

		size_t chunk = MIN(avail, max_chunk);

		/* Ensure enough room remains in tx buffer */
		size_t frame_len = chunk + DECT_LEN_PREFIX;

		if ((tx_buf_offset + frame_len) > sizeof(tx_buf)) {
			LOG_ERR("TX buffer exhausted");
			break;
		}

		uint8_t *frame_ptr = &tx_buf[tx_buf_offset];

		size_t n = serial_read(serial_buf, chunk);

		if (n == 0) {
			LOG_WRN("serial_read returned 0");
			break;
		}

		LOG_DBG("Read %u bytes from serial", n);

		/* Prefix payload length */
		frame_ptr[0] = (n >> 8) & 0xFF;
		frame_ptr[1] = n & 0xFF;

		memcpy(&frame_ptr[DECT_LEN_PREFIX], serial_buf, n);

		uint64_t tx_start = start_time + US_TO_MODEM_TICKS(((uint64_t)i * airtime));

		LOG_DBG("Scheduling DECT TX #%u at %llu us", i, tx_start);

		int err = dect_phy_tx(
			TX_HANDLE,
			&tx_hdr,
			n + DECT_LEN_PREFIX,
			frame_ptr,
			tx_start);

		if (err) {
			LOG_ERR("dect_phy_tx failed: %d", err);
			continue;
		}
		//k_sem_take(&operation_sem, K_FOREVER);
		tx_buf_offset += frame_len;
	}
	return tx_count;
}

void serial_on_pdc(const struct nrf_modem_dect_phy_pdc_event *evt)
{
	if (sync_flag)
  {
		return;
	}

	LOG_INF("PDC event received: len=%d", evt->len);

	const uint8_t *data = (const uint8_t *)evt->data;

	LOG_HEXDUMP_INF(data, evt->len, "PDC EVENT");

	if (evt->len < DECT_LEN_PREFIX) {
		LOG_WRN("PDC event too short: %d", evt->len);
		return;
	}

	uint16_t msg_len = (data[0] << 8) | data[1];
	LOG_DBG("Decoded message length: %d", msg_len);

	if (msg_len == 0) {
		LOG_WRN("Received empty message");
		return;
	}

	if (msg_len > evt->len - DECT_LEN_PREFIX) {
		LOG_ERR("Invalid length: msg_len=%d, available=%d", msg_len, evt->len - DECT_LEN_PREFIX);
		return;
	}

	if (msg_len > sizeof(dect_rx_buf)) {
		LOG_ERR("Message too large for buffer: %d", msg_len);
		return;
	}

	memcpy(dect_rx_buf, data + DECT_LEN_PREFIX, msg_len);
	dect_rx_len = msg_len;
	dect_rx_flag = true;
	serial_write(dect_rx_buf, dect_rx_len);

	LOG_DBG("Stored RX message (%d bytes)", msg_len);
};

void sink_serial_on_pdc(const struct nrf_modem_dect_phy_pdc_event *evt)
{	
  LOG_INF("PDC event received: len=%d", evt->len);

	const uint8_t *data = (const uint8_t *)evt->data;

	LOG_HEXDUMP_INF(data, evt->len, "PDC EVENT");

  serial_write(data, evt->len);
}

void test_on_pdc(const struct nrf_modem_dect_phy_pdc_event *evt)
{
  //
}
```

## src/dect_serial.h
```c
#ifndef dectSerial
#define dectSerial
/**
 * Dect_serial is the bridge between serial and dect. It defines
 * pdc function for dect to uart,
 * it creates functions to easily send packages from serial buffer to dect devices.
 * This is encapsulated by a custom tx and an rx function.
 */
#include <stdint.h>

#include <zephyr/kernel.h>
#include <zephyr/logging/log.h>
#include <modem/nrf_modem_lib.h>
#include <zephyr/drivers/hwinfo.h>
#include <string.h>

#include "serial.h"
#include "dect_phy.h"

#define FRAME_TX_MCS 3
#define FRAME_TX_SS 2

/**
 * @brief fragments serial traffic and sends via dect.
 * TODO implement adaptive subslot lenght, using shorter lenghts for smaller frames.
 * @return number of scheduled transmissions
 *
 * @param duration duration in modem units
 */
int serial_to_dect(uint64_t start_time, uint64_t duration);


/**
 * @brief callback for dect to serail functionality. Unpacks packages and forwards them to serial. This is registed as a callback function for dect events. 
 *
 * @param evt standart pdc callback event
 */
void serial_on_pdc(const struct nrf_modem_dect_phy_pdc_event *evt);

/*
 * @brief basic version of serial_on_pdc
 */
void sink_serial_on_pdc(const struct nrf_modem_dect_phy_pdc_event *evt);

/**
 * @brief Registers on_pdc function as callback
 */
void init_dect_serial();

#endif
```

## src/dect_uart.c
```c
#include <zephyr/kernel.h>
#include <zephyr/device.h>
#include <zephyr/net_buf.h>
#include <zephyr/logging/log.h>
#include <zephyr/drivers/uart.h>

/*
 * UART1 to tx rx eth packets to and from the rpi pico
 * Rx pin: P0.28
 * Tx pin: P0.29
 * this code is pulled from the zephyr sample code drivers/uart/async_api
 */

/* change this to any other UART peripheral if desired */
#define UART_DEVICE_NODE DT_NODELABEL(uart1) // uart1

/* Maximum number of packets to generate per iteration */
#define LOOP_ITER_MAX_TX 4
/* Maximum size of our TX packets */
#define MAX_TX_LEN 32
#define RX_CHUNK_LEN 32

/* Buffer pool for our TX payloads */
NET_BUF_POOL_DEFINE(tx_pool, LOOP_ITER_MAX_TX, MAX_TX_LEN, 0, NULL);

struct k_fifo tx_queue;
struct net_buf *tx_pending_buffer;
uint8_t async_rx_buffer[2][RX_CHUNK_LEN];
volatile uint8_t async_rx_buffer_idx;

bool rxReady = false;
static struct k_work_delayable rxReadyTaskHandle;

static const struct device *const uart_dev = DEVICE_DT_GET(UART_DEVICE_NODE);

LOG_MODULE_REGISTER(dect_uart, LOG_LEVEL_ERR);

static void uart_callback(const struct device *dev, struct uart_event *evt, void *user_data)
{
	struct net_buf *buf;
	int rc;

	LOG_DBG("EVENT: %d", evt->type);

	switch (evt->type) {
	case UART_TX_DONE:
		LOG_DBG("TX complete %p", tx_pending_buffer);

		/* Free TX buffer */
		net_buf_unref(tx_pending_buffer);
		tx_pending_buffer = NULL;

		/* Handle any queued buffers */
		buf = k_fifo_get(&tx_queue, K_NO_WAIT);
		if (buf != NULL) {
			rc = uart_tx(dev, buf->data, buf->len, 0);
			if (rc != 0) {
				LOG_ERR("TX from ISR failed (%d)", rc);
				net_buf_unref(buf);
			} else {
				tx_pending_buffer = buf;
			}
		}
		break;
	case UART_RX_BUF_REQUEST:
		/* Return the next buffer index */
		LOG_DBG("Providing buffer index %d", async_rx_buffer_idx);
		rc = uart_rx_buf_rsp(dev, async_rx_buffer[async_rx_buffer_idx],
				     sizeof(async_rx_buffer[0]));
		__ASSERT_NO_MSG(rc == 0);
		async_rx_buffer_idx = async_rx_buffer_idx ? 0 : 1;
		break;
	case UART_RX_BUF_RELEASED:
	case UART_RX_DISABLED:
		break;
	case UART_RX_RDY:
		LOG_HEXDUMP_INF(evt->data.rx.buf + evt->data.rx.offset, evt->data.rx.len, "RX_RDY");
    k_work_schedule(&rxReadyTaskHandle, K_NO_WAIT);
		rxReady = true;
		break;
	default:
		LOG_WRN("Unhandled event %d", evt->type);
	}
}

// static k_work_delayable dectUartTaskHandle;
void DectUart_RxReadyTask(void)
{
	rxReady = false;
	LOG_INF("%s fired!!!!", __FUNCTION__);
}

int DectUart_Init(void)
{
	bool rx_enabled = false;
	int loop_counter = 0;
	uint8_t num_tx;
	int tx_len;
	int rc;

	// Register the async interrupt handler
	uart_callback_set(uart_dev, uart_callback, (void *)uart_dev);

	async_rx_buffer_idx = 1;
	uart_rx_enable(uart_dev, async_rx_buffer[0], RX_CHUNK_LEN, 100);

	// Kick off our handler task
	// k_work_init(dectUartTaskHandle, DectUart_Task);

	// k_work_init_delayable(&rxReadyTaskHandle, DectUart_RxReadyTask);

	return 0;
}

/*
* attempt 1: send everything without caring about packet encapsulations
*
*/

int DectUart_Tx(uint8_t *buf, uint16_t len)
{
	LOG_INF("%s", __FUNCTION__);
	struct net_buf *tx_buf = net_buf_alloc(&tx_pool, K_FOREVER);
	memcpy(tx_buf->data, buf, len); // do we even need this?
	net_buf_add(tx_buf, len);

	LOG_HEXDUMP_INF(tx_buf->data, len, "TX HEX DUMP");

	int ret = uart_tx(uart_dev, tx_buf->data, tx_buf->len, SYS_FOREVER_US);
	if (ret == 0)
	{
		tx_pending_buffer = tx_buf;
	}
	else if (ret == -EBUSY)
	{
		LOG_DBG("Queueing buffer %p", tx_buf);
		k_fifo_put(&tx_queue, tx_buf);
	}
	else
	{
		LOG_ERR("%s Unknown error! %d", __FUNCTION__, ret);
	}
	return ret;
}

void DectUart_Test(void)
{
	char *teststr = "aaaaaaaabbbbbbbbccccccccdddddddd\r\n";
  // uint8_t testbuf[] = {0xC0, 0xC4, 0xFA, 0xCE, 0x05, 0x00, 0xaa, 0xbb, 0xcc, 0xdd, 0xee};
	uint32_t magic = 0xCEFAC4C0;
	uint16_t len = 0x0005;
	const uint8_t header[] = {0xC0, 0xC4, 0xFA, 0xCE, 32, 0x00};
	const uint8_t pl[] = {0x30, 0x31, 0x32, 0x33, 0x34};
	int ret = DectUart_Tx(header, 6);
	k_sleep(K_USEC(100));
	ret = DectUart_Tx(teststr, 32);
	// int ret = DectUart_Tx(teststr, 32);
}
```

## src/dect_uart.h
```c
#include <stdint.h>

void DectUart_Init(void);
void DectUart_Tx(uint8_t *buf, uint16_t len);
void DectUart_Test(void);
```

## src/led.c
```c
#include <zephyr/kernel.h>
#include <zephyr/drivers/gpio.h>
#include <stdbool.h>

#define LED0_NODE DT_ALIAS(led0)
#define LED1_NODE DT_ALIAS(led1)
#define LED2_NODE DT_ALIAS(led2)
#define LED3_NODE DT_ALIAS(led3)
#define NUM_LEDS 4

static const struct gpio_dt_spec leds[NUM_LEDS] = {GPIO_DT_SPEC_GET(LED0_NODE, gpios), GPIO_DT_SPEC_GET(LED1_NODE, gpios), GPIO_DT_SPEC_GET(LED2_NODE, gpios), GPIO_DT_SPEC_GET(LED3_NODE, gpios)};

int led_init(void)
{
	int ret = 0;
	for (int i = 0; i < NUM_LEDS; i++)
	{
		ret |= gpio_pin_configure_dt(&leds[i], GPIO_OUTPUT_INACTIVE);
	}
	return ret;
}

int led_set(int lednum, bool on)
{
	if (lednum < NUM_LEDS)
		return gpio_pin_set_dt(&leds[lednum], (int) on);
	else
		return 1;
}
```

## src/led.h
```c
#ifndef LED_H
#define LED_H

#define TX_LED_ID (0)
#define RX_LED_ID (1)

#define MASTER_LED_ID (2)
#define SLAVE_LED_ID (3)

int led_init(void);
int led_set(int lednum, bool on);
#endif
```
